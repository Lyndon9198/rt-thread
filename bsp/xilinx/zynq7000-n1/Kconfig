## bsp/xilinx/zynq7000-n1/Kconfig
```kconfig
mainmenu "RT-Thread Project Configuration"

BSP_DIR := .
RTT_DIR := ../../..
PKGS_DIR := packages

source "$(RTT_DIR)/Kconfig"
osource "$PKGS_DIR/Kconfig"

menu "N1 Zynq-7000 BSP"

config SOC_XILINX_ZYNQ7000
    bool
    default y
    select ARCH_ARM_CORTEX_A9
    select RT_USING_GIC_V2
    select RT_USING_COMPONENTS_INIT
    select RT_USING_USER_MAIN

config BSP_USING_UART0
    bool "Enable PS UART0"
    default y

config BSP_USING_GPIO
    bool "Enable PS/EMIO and AXI GPIO"
    default y
    select RT_USING_PIN

config BSP_USING_GEM0
    bool "Enable GEM0 Ethernet with PHY address 7"
    default y
    select RT_USING_DM
    select RT_USING_DEV_BUS
    select RT_USING_ETHERNET
    select RT_ETHERNET_CADENCE
    select RT_USING_PHY_V2
    select RT_USING_DMA
    select RT_USING_OFW
    select RT_USING_BUILTIN_FDT
    select RT_USING_CLK
    select RT_USING_SAL
    select RT_USING_LWIP
    select RT_USING_NETDEV

config RT_LWIP_USING_LWIPERF
    bool "Enable iperf2-compatible TCP throughput server"
    default y
    depends on BSP_USING_GEM0

config RT_BUILTIN_FDT_PATH
    default "zynq7000-n1.dtb" if BSP_USING_GEM0

endmenu
```

## bsp/xilinx/zynq7020-atk-navigator/Kconfig
```kconfig
mainmenu "RT-Thread Project Configuration"

BSP_DIR := .
RTT_DIR := ../../..
PKGS_DIR := packages

source "$(RTT_DIR)/Kconfig"
osource "$PKGS_DIR/Kconfig"

menu "ALIENTEK Navigator ZYNQ7020 BSP"

config RT_USING_FPU
    bool

config SOC_XILINX_ZYNQ7000
    bool
    default y
    select ARCH_ARM_CORTEX_A9
    select RT_USING_GIC_V2
    select RT_USING_FPU
    select RT_USING_COMPONENTS_INIT
    select RT_USING_USER_MAIN

config BSP_USING_UART0
    bool "Enable PS UART0"
    default y
    select RT_USING_SERIAL

config BSP_USING_GPIO
    bool "Enable PS GPIO"
    default y
    select RT_USING_PIN

config BSP_USING_AXI_GPIO0
    bool "Enable AXI GPIO0 (two PL LEDs)"
    default y
    depends on BSP_USING_GPIO

config BSP_USING_TOUCH_I2C
    bool "Enable GPIO I2C bus for the touch controller"
    default y
    depends on BSP_USING_GPIO
    select RT_USING_I2C
    select RT_USING_SOFT_I2C
    select RT_USING_SOFT_I2C0

config BSP_USING_SD1_EMMC
    bool "Enable SD1 eMMC"
    default y
    select RT_USING_SDIO
    select RT_SDIO_SDHCI_ARASAN

config BSP_USING_QSPI0
    bool "Enable PS QSPI0 and W25Q256"
    default y
    select RT_USING_SPI
    select RT_USING_SFUD
    select RT_SFUD_USING_SFDP
    select RT_SFUD_USING_FLASH_INFO_TABLE

config BSP_USING_USB0_HOST
    bool "Enable PS USB0 host (ULPI)"
    default y
    select RT_USING_CHERRYUSB
    select RT_CHERRYUSB_HOST
    select RT_CHERRYUSB_HOST_HID
    select RT_CHERRYUSB_HOST_MSC

config RT_SOFT_I2C0_HAS_PIN_DEFAULT
    default y if BSP_USING_TOUCH_I2C

config RT_SOFT_I2C0_SCL_PIN_DEFAULT
    default 64 if BSP_USING_TOUCH_I2C

config RT_SOFT_I2C0_SDA_PIN_DEFAULT
    default 62 if BSP_USING_TOUCH_I2C

config BSP_USING_WDT
    bool "Enable PS watchdog"
    default y
    select RT_USING_WDT

config BSP_USING_TTC0_TIMER0
    bool "Enable TTC0 timer0"
    default y
    select RT_USING_CLOCK_TIME

config BSP_USING_CAN0
    bool "Enable PS CAN0"
    default y
    select RT_USING_CAN

config BSP_USING_GEM0
    bool "Enable PS GEM0 Ethernet"
    default y
    select RT_USING_DM
    select RT_USING_DEV_BUS
    select RT_USING_ETHERNET
    select RT_ETHERNET_CADENCE
    select RT_USING_PHY_V2
    select RT_USING_DMA
    select RT_USING_OFW
    select RT_USING_BUILTIN_FDT
    select RT_USING_CLK
    select RT_USING_SAL
    select RT_USING_LWIP
    select RT_USING_NETDEV

config RT_BUILTIN_FDT_PATH
    default "zynq7020-atk-navigator.dtb" if BSP_USING_GEM0

endmenu
```
